## linux-5.10.10/Documentation/devicetree/bindings/iio/accel/st_lis2dw12.yaml
```yaml
# SPDX-License-Identifier: (GPL-2.0 OR BSD-2-Clause)
%YAML 1.2
---
$id: http://devicetree.org/schemas/iio/accel/st,lis2dw12.yaml#
$schema: http://devicetree.org/meta-schemas/core.yaml#

title: STM 3 Axis Accelerometer Mems sensors

maintainers:
  - Lorenzo Bianconi <lorenzo.bianconi@st.com>

description:
  Devices have both I2C and SPI interfaces.

properties:
  compatible:
    enum:
      - st,lis2dw12
      - st,iis2dlpc

  reg:
    maxItems: 1

  spi-max-frequency: true

additionalProperties: false

required:
  - compatible
  - reg

examples:
  - |
    #include <dt-bindings/interrupt-controller/irq.h>
    i2c {
        #address-cells = <1>;
        #size-cells = <0>;

        lis2dw12@18 {
            compatible = "st,lis2dw12";
            reg = <0x18>;
            interrupt-parent = <&gpio0>;
            interrupts = <0 IRQ_TYPE_EDGE_RISING>;
        };

        iis2dlpc@18 {
            compatible = "st,iis2dlpc";
            reg = <0x18>;
            interrupt-parent = <&gpiof>;
            interrupts = <0 IRQ_TYPE_EDGE_RISING>;
        };
    };
...
```

## linux-5.10.10/Documentation/devicetree/bindings/iio/imu/st_ism330dhcx.yaml
```yaml
# SPDX-License-Identifier: (GPL-2.0 OR BSD-2-Clause)
%YAML 1.2
---
$id: http://devicetree.org/schemas/iio/imu/st,ism330dhcx.yaml#
$schema: http://devicetree.org/meta-schemas/core.yaml#

title: STM 6-axis (acc + gyro) imu Mems sensors

maintainers:
  - Mario Tesi <mario.tesi@st.com>

description:
  Devices have both I2C and SPI interfaces.

properties:
  compatible:
    enum:
      - st,ism330dhcx

  reg:
    maxItems: 1

  st,drdy-int-pin:
    enum:
      - 1
      - 2

  spi-max-frequency: true

additionalProperties: false

required:
  - compatible
  - reg

examples:
  - |
    #include <dt-bindings/interrupt-controller/irq.h>
    i2c {
        #address-cells = <1>;
        #size-cells = <0>;

        ism330dhcx@6a {
            compatible = "st,ism330dhcx";
            reg = <0x6a>;
            interrupt-parent = <&gpio0>;
            interrupts = <0 IRQ_TYPE_EDGE_RISING>;
            st,drdy-int-pin: 1;
        };
    };
...
```

## linux-5.10.10/Documentation/devicetree/bindings/iio/magnetometer/st_mag40.yaml
```yaml
# SPDX-License-Identifier: (GPL-2.0 OR BSD-2-Clause)
%YAML 1.2
---
$id: http://devicetree.org/schemas/iio/magnetometer/st,mag40.yaml#
$schema: http://devicetree.org/meta-schemas/core.yaml#

title: STM Magnetomter Mems sensors

maintainers:
  - Armando Visconti <armando.visconti@st.com>
  - Lorenzo Bianconi <lorenzo.bianconi@st.com>

description:
  Devices have both I2C and SPI interfaces.

properties:
  compatible:
    enum:
      - st,lsm303ah_magn
      - st,lsm303agr_magn
      - st,lis2mdl_magn
      - st,ism303dac_magn
      - st,iis2mdc_magn

  reg:
    maxItems: 1

  spi-max-frequency: true

additionalProperties: false

required:
  - compatible
  - reg

examples:
  - |
    #include <dt-bindings/interrupt-controller/irq.h>
    i2c {
        #address-cells = <1>;
        #size-cells = <0>;

        mag40@1e {
            compatible = "st,lsm303ah_magn";
            reg = <0x1e>;
            interrupt-parent = <&gpio0>;
            interrupts = <0 IRQ_TYPE_EDGE_RISING>;
        };
    };
...
```

## linux-5.10.10/Documentation/devicetree/bindings/iio/pressure/st_lps22hh.yaml
```yaml
# SPDX-License-Identifier: (GPL-2.0 OR BSD-2-Clause)
%YAML 1.2
---
$id: http://devicetree.org/schemas/iio/pressure/st,lps22hh.yaml#
$schema: http://devicetree.org/meta-schemas/core.yaml#

title: Pressure Mems sensor

maintainers:
  - Mario Tesi <mario.tesi@st.com>

description:
  Devices have both I2C and SPI interfaces.

properties:
  compatible:
    enum:
      - st,lps22hh
      - st,lps27hhw

  reg:
    maxItems: 1

  spi-max-frequency: true

additionalProperties: false

required:
  - compatible
  - reg

examples:
  - |
    #include <dt-bindings/interrupt-controller/irq.h>
    i2c {
        #address-cells = <1>;
        #size-cells = <0>;

        lps22hh@5c {
            compatible = "st,lps22hh";
            reg = <0x5c>;
            interrupt-parent = <&gpio0>;
            interrupts = <0 IRQ_TYPE_EDGE_RISING>;
        };

        lps27hhw@5c {
            compatible = "st,lps27hhw";
            reg = <0x5c>;
            interrupt-parent = <&gpiof>;
            interrupts = <0 IRQ_TYPE_EDGE_RISING>;
        };
    };
...
```

## linux-5.10.10/Documentation/devicetree/bindings/iio/temperature/stts22h.yaml
```yaml
# SPDX-License-Identifier: (GPL-2.0 OR BSD-2-Clause)
%YAML 1.2
---
$id: http://devicetree.org/schemas/iio/temperature/stts22h.yaml#
$schema: http://devicetree.org/meta-schemas/core.yaml#

title: STM Temperature Mems sensors

maintainers:
  - Mario Tesi <mario.tesi@st.com>

description:
  Device have I2C interface.

properties:
  compatible:
      - st,stts22h

  reg:
    maxItems: 1

additionalProperties: false

required:
  - compatible
  - reg

examples:
  - |
    #include <dt-bindings/interrupt-controller/irq.h>
    i2c {
        #address-cells = <1>;
        #size-cells = <0>;

        mag40@18 {
            compatible = "st,stts22h";
            reg = <0x38>;
        };
    };
...
```

## linux-5.10.10/arch/arm/mach-stm32/Kconfig.rej
```kconfig
--- arch/arm/mach-stm32/Kconfig
+++ arch/arm/mach-stm32/Kconfig
@@ -46,6 +46,8 @@ if ARCH_MULTI_V7
 config MACH_STM32MP157
 	bool "STMicroelectronics STM32MP157"
 	select ARM_ERRATA_814220
+	select REGULATOR
+	select ARCH_SUPPORTS_RT
 	default y
 
 endif # ARMv7-A
```

## linux-5.10.10/drivers/cpufreq/Kconfig.arm.rej
```kconfig
--- drivers/cpufreq/Kconfig.arm
+++ drivers/cpufreq/Kconfig.arm
@@ -289,6 +289,13 @@ config ARM_STI_CPUFREQ
 	  this config option if you wish to add CPUFreq support for STi based
 	  SoCs.
 
+config ARM_STM32_CPUFREQ
+	tristate "STM32 CPUFreq support"
+	depends on MACH_STM32MP157
+	default y
+	help
+	  This adds the CPUFreq driver support for STM32 MPU SOCs.
+
 config ARM_TANGO_CPUFREQ
 	bool
 	depends on CPUFREQ_DT && ARCH_TANGO
```

## linux-5.10.10/drivers/cpuidle/Kconfig.arm.rej
```kconfig
--- drivers/cpuidle/Kconfig.arm
+++ drivers/cpuidle/Kconfig.arm
@@ -91,6 +91,14 @@ config ARM_EXYNOS_CPUIDLE
 	help
 	  Select this to enable cpuidle for Exynos processors.
 
+config ARM_STM32_CPUIDLE
+	bool "Cpu Idle Driver for the STM32 processors"
+	depends on MACH_STM32MP157
+	select DT_IDLE_STATES
+	select ARCH_NEEDS_CPU_IDLE_COUPLED if SMP
+	help
+	  Select this to enable cpuidle for STM32 processors.
+
 config ARM_MVEBU_V7_CPUIDLE
 	bool "CPU Idle Driver for mvebu v7 family processors"
 	depends on (ARCH_MVEBU || COMPILE_TEST) && !ARM64
```

## linux-5.10.10/drivers/iio/accel/st_lis2dw12/Kconfig
```kconfig
# SPDX-License-Identifier: GPL-2.0-only
config IIO_ST_LIS2DW12
	tristate "STMicroelectronics LIS2DW12/IIS2DLPC Accelerometer Driver"
	depends on (I2C || SPI)
	select IIO_BUFFER
	select IIO_KFIFO_BUF
	select IIO_ST_LIS2DW12_I2C if (I2C)
	select IIO_ST_LIS2DW12_SPI if (SPI)
	help
	  Say yes here to build support for the LIS2DW12 and IIS2DLPC accelerometer.

	  This driver can also be built as a module. If so, will be created
	  these modules:
	  - st_lisdw12 (core functions for the driver [it is mandatory]);
	  - st_lisdw12_i2c (necessary for the I2C devices [optional*]);
	  - st_lisdw12_spi (necessary for the SPI devices [optional*]);

	  (*) one of these is necessary to do something.

config IIO_ST_LIS2DW12_I2C
	tristate
	depends on IIO_ST_LIS2DW12
	depends on I2C

config IIO_ST_LIS2DW12_SPI
	tristate
	depends on IIO_ST_LIS2DW12
	depends on SPI
```

## linux-5.10.10/drivers/mailbox/Kconfig.rej
```kconfig
--- drivers/mailbox/Kconfig
+++ drivers/mailbox/Kconfig
@@ -16,6 +16,13 @@ config ARM_MHU
 	  The controller has 3 mailbox channels, the last of which can be
 	  used in Secure mode only.
 
+config ARM_SMC_MBOX
+	tristate "Generic ARM smc mailbox"
+	depends on OF && HAVE_ARM_SMCCC
+	help
+	  Generic mailbox driver which uses ARM smc calls to call into
+	  firmware for triggering mailboxes.
+
 config IMX_MBOX
 	tristate "i.MX Mailbox"
 	depends on ARCH_MXC || COMPILE_TEST
```

## linux-5.10.10/drivers/mfd/Kconfig.rej
```kconfig
--- drivers/mfd/Kconfig
+++ drivers/mfd/Kconfig
@@ -2052,6 +2052,16 @@ config MFD_STPMIC1
 	  To compile this driver as a module, choose M here: the
 	  module will be called stpmic1.
 
+config MFD_STM32MP1_PWR
+	bool "STM32MP1 wake-up pins"
+	depends on MACH_STM32MP157
+	default y
+	help
+	  Select this option to enable STM32 PWR Wake-up pins driver.
+
+	  This driver provides interruptions that can be used to wake-up from
+	  suspend.
+
 config MFD_STMFX
 	tristate "Support for STMicroelectronics Multi-Function eXpander (STMFX)"
 	depends on I2C
```

## linux-5.10.10/drivers/perf/Kconfig.rej
```kconfig
--- drivers/perf/Kconfig
+++ drivers/perf/Kconfig
@@ -106,6 +106,13 @@ config QCOM_L3_PMU
 	   Adds the L3 cache PMU into the perf events subsystem for
 	   monitoring L3 cache events.
 
+config STM32_DDR_PMU
+	tristate "STM32 DDR PMU"
+	depends on MACH_STM32MP157
+	default m
+	help
+	  Support for STM32 DDR performance monitor (DDRPERFM).
+
 config THUNDERX2_PMU
 	tristate "Cavium ThunderX2 SoC PMU UNCORE"
 	depends on ARCH_THUNDER2 && ARM64 && ACPI && NUMA
```

## linux-5.10.10/drivers/remoteproc/Kconfig.rej
```kconfig
--- drivers/remoteproc/Kconfig
+++ drivers/remoteproc/Kconfig
@@ -23,6 +23,25 @@ config REMOTEPROC_CDEV
 
 	  It's safe to say N if you don't want to use this interface.
 
+config REMOTEPROC_SRM_CORE
+	tristate "Remoteproc System Resource Manager core"
+	depends on RPMSG
+	help
+	  Say y here to enable the core driver of the remoteproc System Resource
+	  Manager (SRM).
+	  The SRM handles resources allocated to remote processors.
+	  The core part is in charge of controlling the device children.
+
+config REMOTEPROC_SRM_DEV
+	tristate "Remoteproc System Resource Manager device"
+	depends on REMOTEPROC_SRM_CORE
+	help
+	  Say y here to enable the device driver of the remoteproc System
+	  Resource Manager (SRM).
+	  The SRM handles resources allocated to remote processors.
+	  The device part is in charge of reserving and initializing resources
+	  for a peripheral assigned to a coprocessor.
+
 config IMX_REMOTEPROC
 	tristate "IMX6/7 remoteproc support"
 	depends on ARCH_MXC
@@ -288,6 +307,15 @@ config TI_K3_R5_REMOTEPROC
 	  It's safe to say N here if you're not interested in utilizing
 	  a slave processor.
 
+
+config TEE_REMOTEPROC
+	tristate "trusted firmware Support by a Trusted Application"
+	depends on OPTEE
+	help
+	  Support for trusted remote processors firmware. The firmware
+	  authentication and/or decryption are managed by a trusted application.
+	  This can be either built-in or a loadable module.
+
 endif # REMOTEPROC
 
 endmenu
```

## linux-5.10.10/drivers/reset/Kconfig.rej
```kconfig
--- drivers/reset/Kconfig
+++ drivers/reset/Kconfig
@@ -180,12 +180,6 @@ config RESET_SIMPLE
 	   - Allwinner SoCs
 	   - ZTE's zx2967 family
 
-config RESET_STM32MP157
-	bool "STM32MP157 Reset Driver" if COMPILE_TEST
-	default MACH_STM32MP157
-	help
-	  This enables the RCC reset controller driver for STM32 MPUs.
-
 config RESET_SOCFPGA
 	bool "SoCFPGA Reset Driver" if COMPILE_TEST && !ARCH_SOCFPGA
 	default ARCH_SOCFPGA
```

## linux-5.10.10/drivers/rtc/Kconfig.rej
```kconfig
--- drivers/rtc/Kconfig
+++ drivers/rtc/Kconfig
@@ -1884,6 +1884,7 @@ config RTC_DRV_R7301
 config RTC_DRV_STM32
 	tristate "STM32 RTC"
 	select REGMAP_MMIO
+	depends on COMMON_CLK
 	depends on ARCH_STM32 || COMPILE_TEST
 	help
 	   If you say yes here you get support for the STM32 On-Chip
```

## linux-5.10.10/drivers/soc/Kconfig.rej
```kconfig
--- drivers/soc/Kconfig
+++ drivers/soc/Kconfig
@@ -15,6 +15,7 @@ source "drivers/soc/renesas/Kconfig"
 source "drivers/soc/rockchip/Kconfig"
 source "drivers/soc/samsung/Kconfig"
 source "drivers/soc/sifive/Kconfig"
+source "drivers/soc/st/Kconfig"
 source "drivers/soc/sunxi/Kconfig"
 source "drivers/soc/tegra/Kconfig"
 source "drivers/soc/ti/Kconfig"
```

## linux-5.10.10/sound/soc/codecs/Kconfig.rej
```kconfig
--- sound/soc/codecs/Kconfig
+++ sound/soc/codecs/Kconfig
@@ -1642,7 +1642,7 @@ config SND_SOC_WM8993
 	depends on I2C
 
 config SND_SOC_WM8994
-	tristate
+	tristate "Wolfson Microelectronics WM8994 codec"
 
 config SND_SOC_WM8995
 	tristate
```
